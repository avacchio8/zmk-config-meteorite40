## config/west.yml
```yaml
manifest:
  remotes:
    - name: zmkfirmware
      url-base: https://github.com/zmkfirmware
    - name: iwk7273
      url-base: https://github.com/iwk7273
  projects:
    - name: zmk
      remote: iwk7273
      revision: 24dd16125d36240cc68aa75bceaea3966dbe07b2
      import: app/west.yml
    - name: zmk-pmw3610-driver
      remote: iwk7273
      revision: main
    - name: zmk-feature-meteorite-config
      remote: iwk7273
      revision: 3ca678abe571fb3213ebaf7b0dea8a1e227a9260
  self:
    path: config
```
